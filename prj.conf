## CMakeLists.txt
```
#
# Copyright (c) 2018 Nordic Semiconductor
#
# SPDX-License-Identifier: LicenseRef-Nordic-5-Clause
#
cmake_minimum_required(VERSION 3.20.0)

find_package(Zephyr REQUIRED HINTS $ENV{ZEPHYR_BASE})
project(peripheral_lbs)

# NORDIC SDK APP START
target_sources(app PRIVATE
  src/main.c
  src/force_sensor.c
  src/force_service.c
)

# NORDIC SDK APP END
```

## prj.conf
```kconfig
#
# Copyright (c) 2018 Nordic Semiconductor
#
# SPDX-License-Identifier: LicenseRef-Nordic-5-Clause
#
CONFIG_NCS_SAMPLES_DEFAULTS=y

CONFIG_BT=y
CONFIG_BT_PERIPHERAL=y
CONFIG_BT_DEVICE_NAME="PincherZ"

# Enable DK buttons
CONFIG_DK_LIBRARY=y

CONFIG_SYSTEM_WORKQUEUE_STACK_SIZE=2048
```

## src/main.c
```c
#include <zephyr/kernel.h>
#include <zephyr/sys/printk.h>
#include <zephyr/bluetooth/bluetooth.h>
#include <zephyr/bluetooth/conn.h>
#include <zephyr/bluetooth/hci.h>
#include <zephyr/settings/settings.h>
#include <dk_buttons_and_leds.h>

#include "force_service.h"
#include "force_sensor.h"

#define DEVICE_NAME      CONFIG_BT_DEVICE_NAME
#define DEVICE_NAME_LEN  (sizeof(DEVICE_NAME) - 1)

#define RUN_STATUS_LED   DK_LED1
#define CON_STATUS_LED   DK_LED2
#define TARE_BUTTON      DK_BTN1_MSK
#define SAMPLE_PERIOD_MS 100

static struct k_work adv_work;
static volatile bool streaming;

static const struct bt_data ad[] = {
	BT_DATA_BYTES(BT_DATA_FLAGS, (BT_LE_AD_GENERAL | BT_LE_AD_NO_BREDR)),
	BT_DATA(BT_DATA_NAME_COMPLETE, DEVICE_NAME, DEVICE_NAME_LEN),
};

static const struct bt_data sd[] = {
	BT_DATA_BYTES(BT_DATA_UUID128_ALL, FORCE_SVC_UUID_VAL),
};

static void adv_work_handler(struct k_work *work)
{
	int err = bt_le_adv_start(BT_LE_ADV_CONN_FAST_2, ad, ARRAY_SIZE(ad),
				  sd, ARRAY_SIZE(sd));
	if (err) {
		printk("Advertising failed to start (err %d)\n", err);
		return;
	}
	printk("Advertising successfully started\n");
}

static void advertising_start(void)
{
	k_work_submit(&adv_work);
}

static void connected(struct bt_conn *conn, uint8_t err)
{
	if (err) {
		printk("Connection failed, err 0x%02x %s\n", err, bt_hci_err_to_str(err));
		return;
	}
	printk("Connected\n");
	dk_set_led_on(CON_STATUS_LED);
}

static void disconnected(struct bt_conn *conn, uint8_t reason)
{
	printk("Disconnected, reason 0x%02x %s\n", reason, bt_hci_err_to_str(reason));
	dk_set_led_off(CON_STATUS_LED);
	streaming = false;
}

static void recycled_cb(void)
{
	advertising_start();
}

BT_CONN_CB_DEFINE(conn_callbacks) = {
	.connected    = connected,
	.disconnected = disconnected,
	.recycled     = recycled_cb,
};

static void on_command(uint8_t cmd)
{
	switch (cmd) {
	case FORCE_CMD_TARE:  force_sensor_tare(); break;
	case FORCE_CMD_START: streaming = true;    break;
	case FORCE_CMD_STOP:  streaming = false;   break;
	default: printk("Unknown command 0x%02x\n", cmd);
	}
}

static void button_changed(uint32_t button_state, uint32_t has_changed)
{
	if ((has_changed & TARE_BUTTON) && (button_state & TARE_BUTTON)) {
		force_sensor_tare();
	}
}

static void sample_thread_fn(void *a, void *b, void *c)
{
	for (;;) {
		k_sleep(K_MSEC(SAMPLE_PERIOD_MS));
		if (!streaming || !force_service_notify_enabled()) {
			continue;
		}
		struct force_sample s = {
			.t_ms    = k_uptime_get_32(),
			.force_g = force_sensor_read_g(),
		};
		int err = force_service_notify(&s);
		if (err && err != -ENOTCONN) {
			printk("Notify failed (err %d)\n", err);
		}
	}
}
K_THREAD_DEFINE(sample_tid, 1024, sample_thread_fn, NULL, NULL, NULL, 7, 0, 0);

int main(void)
{
	int blink = 0;
	int err;

	printk("Starting PincherZ\n");

	err = dk_leds_init();
	if (err) { printk("LEDs init failed (err %d)\n", err); return 0; }

	err = dk_buttons_init(button_changed);
	if (err) { printk("Buttons init failed (err %d)\n", err); return 0; }

	err = bt_enable(NULL);
	if (err) { printk("Bluetooth init failed (err %d)\n", err); return 0; }

	if (IS_ENABLED(CONFIG_SETTINGS)) {
		settings_load();
	}

	force_service_init(on_command);

	k_work_init(&adv_work, adv_work_handler);
	advertising_start();

	for (;;) {
		dk_set_led(RUN_STATUS_LED, (++blink) % 2);
		k_sleep(K_MSEC(1000));
	}
}
```

## src/force_sensor.c
```c
#include <zephyr/kernel.h>
#include "force_sensor.h"

static int32_t offset_g;

// Generating a triangle reading
static int32_t raw_g(void)
{
	uint32_t phase = k_uptime_get_32() % 4000;
	int32_t tri = (phase < 2000) ? phase : (4000 - phase);
	return tri * 20;
}

int32_t force_sensor_read_g(void)
{
	return raw_g() - offset_g;
}

void force_sensor_tare(void)
{
	offset_g = raw_g();
}
```

## src/force_sensor.h
```c
#ifndef FORCE_SENSOR_H_
#define FORCE_SENSOR_H_
#include <stdint.h>

int32_t force_sensor_read_g(void);
void force_sensor_tare(void);

#endif
```

## src/force_service.c
```c
#include <zephyr/bluetooth/bluetooth.h>
#include <zephyr/bluetooth/gatt.h>
#include <zephyr/sys/printk.h>
#include "force_service.h"

// UUID objects for different commands
static const struct bt_uuid_128 svc_uuid =
	BT_UUID_INIT_128(FORCE_SVC_UUID_VAL);
static const struct bt_uuid_128 force_uuid =
	BT_UUID_INIT_128(FORCE_UUID_VAL);
static const struct bt_uuid_128 cmd_uuid =
	BT_UUID_INIT_128(CMD_UUID_VAL);

static bool notify_on;	// Has the user subscribed to notifications
static force_cmd_cb_t cmd_cb; // Callback created by force_service_init

static void ccc_changed(const struct bt_gatt_attr *attr, uint16_t value)
{
	notify_on = (value == BT_GATT_CCC_NOTIFY); //Generic Attribute Profile
	printk("Force notifications %s\n", notify_on ? "enabled" : "disabled");
}

// conn = which connection wrote
// attr = which attribute was written
static ssize_t write_cmd(struct bt_conn *conn, const struct bt_gatt_attr *attr,
			 const void *buf, uint16_t len, uint16_t offset, uint8_t flags)
{
	// The length of the message has to be exactlyy 1 byte
	if (offset != 0 || len != 1) {
		return BT_GATT_ERR(BT_ATT_ERR_INVALID_ATTRIBUTE_LEN);
	}
	if (cmd_cb) { // Ensures that cmd_cb has a value or else the pointer would call NULL and crash
		cmd_cb(((const uint8_t *)buf)[0]);
	}
	return len;
}

// CCC = Client Characteristic Configuration
// BT_GATT_PRIMARY_SERVICE = Service with this UUID begins here
// BT_GATT_CHARACTERISTIC = Force Data
// 		Arguments: UUID, notify properties, permission
// Second characteristic is the command chanell
BT_GATT_SERVICE_DEFINE(force_svc,
	BT_GATT_PRIMARY_SERVICE(&svc_uuid),
	BT_GATT_CHARACTERISTIC(&force_uuid.uuid, BT_GATT_CHRC_NOTIFY,
			       BT_GATT_PERM_NONE, NULL, NULL, NULL),
	BT_GATT_CCC(ccc_changed, BT_GATT_PERM_READ | BT_GATT_PERM_WRITE),
	BT_GATT_CHARACTERISTIC(&cmd_uuid.uuid, BT_GATT_CHRC_WRITE,
			       BT_GATT_PERM_WRITE, NULL, write_cmd, NULL),
);

// Stores callback pointer
void force_service_init(force_cmd_cb_t cb)
{
	cmd_cb = cb;
}

// Returns notify_on flag
bool force_service_notify_enabled(void)
{
	return notify_on;
}

// Sends sample packet
int force_service_notify(const struct force_sample *s)
{
	return bt_gatt_notify_uuid(NULL, &force_uuid.uuid, force_svc.attrs,
				   s, sizeof(*s));
}
```

## src/force_service.h
```c
// Only define header once
#ifndef FORCE_SERVICE_H_
#define FORCE_SERVICE_H_

#include <stdint.h>
#include <stdbool.h>
#include <zephyr/toolchain.h>
#include <zephyr/bluetooth/uuid.h>

// Generate a UUID for the device
#define FORCE_SVC_UUID_VAL \
	BT_UUID_128_ENCODE(0x7c3a0001, 0x5b1e, 0x4d2a, 0x9f60, 0x3e8a1c0d4b52)

#define FORCE_UUID_VAL \
    BT_UUID_128_ENCODE(0x7c3a0002, 0x5b1e, 0x4d2a, 0x9f60, 0x3e8a1c0d4b52)

#define CMD_UUID_VAL \
    BT_UUID_128_ENCODE(0x7c3a0003, 0x5b1e, 0x4d2a, 0x9f60, 0x3e8a1c0d4b52)

// 1-byte commands
enum force_cmd {
    FORCE_CMD_TARE = 0x01, // Temporary Zero
    FORCE_CMD_START = 0x02,
    FORCE_CMD_STOP = 0x03,
};

struct force_sample
{
    uint32_t t_ms; // Timestamp for Packet
    int32_t force_g; // Reading in grams
} __packed;

typedef void (*force_cmd_cb_t)(uint8_t cmd); // Create a callback alias

void force_service_init(force_cmd_cb_t cb);
bool force_service_notify_enabled(void); // Enable notification sending
int force_service_notify(const struct force_sample *s); // Send one sample as a notification


#endif
```
